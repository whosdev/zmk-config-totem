## config/boards/shields/tenax_xiao/Kconfig.defconfig
```kconfig
if SHIELD_tenax_xiao_LEFT

config ZMK_KEYBOARD_NAME
	default "tenax_xiao"

config ZMK_SPLIT_BLE_ROLE_CENTRAL
	default y

endif


if SHIELD_tenax_xiao_RIGHT

config ZMK_KEYBOARD_NAME
	default "tenax_xiao Right"
	
endif


if SHIELD_tenax_xiao_LEFT || SHIELD_tenax_xiao_RIGHT

config ZMK_SPLIT
	default y
	

if ZMK_DISPLAY

config I2C
	default y

config SSD1306
	default y

config SSD1306_REVERSE_MODE
	default y

endif # ZMK_DISPLAY

if LVGL

config LV_Z_VDB_SIZE
	default 64

config LV_DPI_DEF
	default 148

config LV_Z_BITS_PER_PIXEL
	default 1

endif # LVGL

endif
```

## config/boards/shields/tenax_xiao/Kconfig.shield
```kconfig
# Copyright (c) 2020 Pete Johanson
# SPDX-License-Identifier: MIT

config SHIELD_tenax_xiao_LEFT
	def_bool $(shields_list_contains,tenax_xiao_left)

config SHIELD_tenax_xiao_RIGHT
	def_bool $(shields_list_contains,tenax_xiao_right)
```

## config/boards/shields/tenaxoled/Kconfig.shield
```kconfig
# Copyright (c) 2020 Pete Johanson
# SPDX-License-Identifier: MIT

config SHIELD_TENAX-XIAO_LEFT
	def_bool $(shields_list_contains,tenax-xiao_left)

config SHIELD_TENAX-XIAO_RIGHT
	def_bool $(shields_list_contains,tenax-xiao_right)
```
